## zmk-config/boards/arm/anaphase/Kconfig.board
```kconfig
# SPDX-License-Identifier: MIT

config BOARD_ANAPHASE_LEFT
    bool "anaphase_left"
    depends on SOC_NRF52840_QIAA

config BOARD_ANAPHASE_RIGHT
    bool "anaphase_right"
    depends on SOC_NRF52840_QIAA
```

## zmk-config/boards/arm/anaphase/Kconfig.defconfig
```kconfig
# SPDX-License-Identifier: MIT

if BOARD_ANAPHASE

config ZMK_KEYBOARD_NAME
    default "anaphase"

if USB

config USB_NRFX
    default y

config USB_DEVICE_STACK
    default y

endif # USB

config BT_CTLR
    default BT

config ZMK_BLE
    default y

config ZMK_USB
    default y

config ZMK_BATTERY_NRF_VDDH
    default y

config ZMK_DISPLAY

if ZMK_DISPLAY

config SPI
    default y

config SSD1306
    default y

config LVGL_HOR_RES_MAX
    default 96

config LVGL_VER_RES_MAX
    default 48

config LVGL_VDB_SIZE
    default 100

config LVGL_DPI
    default 148

config LVGL_BITS_PER_PIXEL
    default 1

choice LVGL_COLOR_DEPTH
    default LVGL_COLOR_DEPTH_1

endchoice

endif # ZMK_DISPLAY

endif # BOARD_ANAPHASE
```

## zmk-config/boards/arm/anaphase/anaphase_left_defconfig
```kconfig
# SPDX-License-Identifier: MIT

CONFIG_SOC_SERIES_NRF52X=y
CONFIG_SOC_NRF52840_QIAA=y
CONFIG_BOARD_ANAPHASE_LEFT=y
CONFIG_ZMK_SPLIT=y
CONFIG_ZMK_SPLIT_BLE_ROLE_CENTRAL=y
CONFIG_ZMK_SLEEP=y
CONFIG_ZMK_IDLE_TIMEOUT=30000
CONFIG_ZMK_IDLE_SLEEP_TIMEOUT=3600000

# Enable MPU
CONFIG_ARM_MPU=y

# Enable GPIO
CONFIG_GPIO=y

# Place application at &code_partition address
CONFIG_USE_DT_CODE_PARTITION=y

# Enable NVS for settings
CONFIG_MPU_ALLOW_FLASH_WRITE=y
CONFIG_NVS=y
CONFIG_SETTINGS_NVS=y
CONFIG_FLASH=y
CONFIG_FLASH_PAGE_LAYOUT=y
CONFIG_FLASH_MAP=y

# nRF52840 can handle faster USB polling
CONFIG_USB_HID_POLL_INTERVAL_MS=1

CONFIG_ZMK_DISPLAY=y
CONFIG_ZMK_DISPLAY_WORK_QUEUE_DEDICATED=y
CONFIG_ZMK_DISPLAY_DEDICATED_THREAD_STACK_SIZE=2048
CONFIG_LVGL_USE_THEME_MONO=y

#CONFIG_ZMK_BLE_CLEAR_BONDS_ON_START=y
CONFIG_BT_MAX_CONN=6
#CONFIG_BT_CTLR_TX_PWR_PLUS_8=y
CONFIG_CLOCK_CONTROL_NRF_K32SRC_RC=y
CONFIG_BT_CTLR_TX_PWR_PLUS_8=y
CONFIG_BT_PERIPHERAL_PREF_MIN_INT=6
CONFIG_BT_PERIPHERAL_PREF_MAX_INT=12

CONFIG_ZMK_KSCAN_DEBOUNCE_PRESS_MS=0
CONFIG_ZMK_KSCAN_DEBOUNCE_RELEASE_MS=5
CONFIG_ZMK_HID_CONSUMER_REPORT_USAGES_BASIC=y

# custom status screens
CONFIG_ZMK_DISPLAY_STATUS_SCREEN_CUSTOM=y
CONFIG_CUSTOM_WIDGET_BATTERY_STATUS=y
CONFIG_ZMK_WIDGET_BATTERY_STATUS=n
CONFIG_CUSTOM_WIDGET_OUTPUT_STATUS=n
CONFIG_ZMK_WIDGET_OUTPUT_STATUS=n
CONFIG_CUSTOM_WIDGET_LAYER_STATUS=y
CONFIG_ZMK_WIDGET_LAYER_STATUS=n
CONFIG_CUSTOM_WIDGET_WPM_STATUS=n
CONFIG_ZMK_WIDGET_WPM_STATUS=n


#USB debugging
CONFIG_ZMK_USB_LOGGING=y
#CONFIG_ZMK_USB=n
```
