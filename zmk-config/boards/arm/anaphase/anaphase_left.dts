/**
 * Copyright (c) 2021
 *
 * SPDX-License-Identifier: MIT
 */

#include "anaphase.dtsi"

/{
    kscan0: kscan {
        compatible = "zmk,kscan-gpio-direct";
        label = "KSCAN";

        input-gpios
            = <&gpio1 11 (GPIO_ACTIVE_LOW | GPIO_PULL_UP)>
            , <&gpio1 10 (GPIO_ACTIVE_LOW | GPIO_PULL_UP)>
            , <&gpio0  3 (GPIO_ACTIVE_LOW | GPIO_PULL_UP)>
            , <&gpio0 28 (GPIO_ACTIVE_LOW | GPIO_PULL_UP)>
            , <&gpio1 13 (GPIO_ACTIVE_LOW | GPIO_PULL_UP)>
            , <&gpio0  2 (GPIO_ACTIVE_LOW | GPIO_PULL_UP)>

            , <&gpio0 29 (GPIO_ACTIVE_LOW | GPIO_PULL_UP)>
            , <&gpio0 31 (GPIO_ACTIVE_LOW | GPIO_PULL_UP)>
            , <&gpio0 30 (GPIO_ACTIVE_LOW | GPIO_PULL_UP)>
            , <&gpio0 26 (GPIO_ACTIVE_LOW | GPIO_PULL_UP)>
            , <&gpio0  5 (GPIO_ACTIVE_LOW | GPIO_PULL_UP)>
            , <&gpio1  9 (GPIO_ACTIVE_LOW | GPIO_PULL_UP)>

            , <&gpio0  9 (GPIO_ACTIVE_LOW | GPIO_PULL_UP)>
            , <&gpio0 10 (GPIO_ACTIVE_LOW | GPIO_PULL_UP)>
            , <&gpio1  6 (GPIO_ACTIVE_LOW | GPIO_PULL_UP)>
            , <&gpio1  4 (GPIO_ACTIVE_LOW | GPIO_PULL_UP)>
            , <&gpio1  2 (GPIO_ACTIVE_LOW | GPIO_PULL_UP)>
            , <&gpio1  0 (GPIO_ACTIVE_LOW | GPIO_PULL_UP)>

            , <&gpio0 22 (GPIO_ACTIVE_LOW | GPIO_PULL_UP)>
            , <&gpio0 20 (GPIO_ACTIVE_LOW | GPIO_PULL_UP)>
            , <&gpio0 17 (GPIO_ACTIVE_LOW | GPIO_PULL_UP)>
            ;
    };
};